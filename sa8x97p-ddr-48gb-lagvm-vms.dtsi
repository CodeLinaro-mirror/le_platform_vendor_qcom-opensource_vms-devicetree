// SPDX-License-Identifier: BSD-3-Clause
/*
 * Copyright (c) Qualcomm Technologies, Inc. and/or its subsidiaries.
 */

#include "sa8x97p-vms-la.dtsi"

&soc {
	gh-secure-vm-loader@0 {
		memory-region = <&auto_vm_0_mem_0 &auto_vm_0_mem_1>;
		shared-regions = <&vm_0_glink_cma_mem_1
				&vm_0_glink_cma_mem_2
				&vm_0_glink_cma_mem_3
				&vm_0_glink_cma_mem_4
				&vm_0_glink_cma_mem_5
				&vm_0_glink_cma_mem_6
				&vm_0_glink_cma_mem_7
				&vm_0_cp_pixel
				&vm_0_cp_nonpixel
				&vm_0_cp_bitstream
				&vm_0_cp_b_pt_mem
				&vm_0_cp_p_pt_mem
				&vm_0_cp_np_pt_mem
				&soccp_fe_vm_1
				&dice_vm_0_mem>;
	};
};

&{/reserved-memory} {

	auto_vm_0_mem_1: auto_vm_0_mem_1@BA9000000 {
		no-map;
		reg = <0xB 0xA9000000 0x3 0xE7000000>; /* 15984MB */
	};
};
