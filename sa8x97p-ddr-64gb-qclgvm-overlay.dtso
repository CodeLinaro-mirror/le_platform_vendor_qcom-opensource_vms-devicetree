// SPDX-License-Identifier: BSD-3-Clause
/*
 * Copyright (c) Qualcomm Technologies, Inc. and/or its subsidiaries.
 */

/dts-v1/;
/plugin/;

#include "sa8x97p-ddr-64gb-qclgvm-vms.dtsi"

/ {
	compatible = "qcom,sa8x97p-adp-star", "qcom,sa8x97p-ride-sx", "qcom,sa8797p-iqx-evk";
};

&{/} {
	qcom,sku-id = <0xf 0x20f>;
};
