// SPDX-License-Identifier: BSD-3-Clause
/*
 * Copyright (c) Qualcomm Technologies, Inc. and/or its subsidiaries.
 */

/dts-v1/;
/plugin/;

#include "seca-flex-ddr-64gb-lagvm-vms.dtsi"

/ {
	compatible = "qcom,seca-flex-ride-sx";
};

&{/} {
	qcom,sku-id = <0x300>;
};
