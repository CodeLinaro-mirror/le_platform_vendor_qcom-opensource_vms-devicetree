// SPDX-License-Identifier: BSD-3-Clause
/*
 * Copyright (c) Qualcomm Technologies, Inc. and/or its subsidiaries.
 */

/dts-v1/;
/plugin/;

#include "sa8x97p-ddr-48gb-lagvm-vms.dtsi"

/ {
	compatible = "qcom,sa8x97p-ride-sx", "qcom,sa8x97p-qam-ride-sx";
};

&{/} {
	qcom,sku-id = <0x0 0x200>;
};
