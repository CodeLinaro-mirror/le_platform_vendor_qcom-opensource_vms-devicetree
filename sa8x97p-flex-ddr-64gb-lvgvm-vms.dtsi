// SPDX-License-Identifier: BSD-3-Clause
/*
 * Copyright (c) Qualcomm Technologies, Inc. and/or its subsidiaries.
 */

#include "sa8x97p-vms-lv.dtsi"

&soc {
	gh-secure-vm-loader@1 {
		memory-region = <&auto_vm_1_mem_0 &auto_vm_1_mem_1 &auto_vm_1_mem_2>;
	};
};

&{/reserved-memory} {

	auto_vm_1_mem_2: auto_vm_1_mem_2@8e50000000 {
		no-map;
		reg = <0x8E 0x50000000 0x1 0x37500000>; /*4981MB*/
	};
};
