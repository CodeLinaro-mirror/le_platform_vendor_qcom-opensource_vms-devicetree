// SPDX-License-Identifier: BSD-3-Clause
/*
 * Copyright (c) Qualcomm Technologies, Inc. and/or its subsidiaries.
 */

/dts-v1/;
/plugin/;

#include "seca-flex-ddr-32gb-mgvm-vms.dtsi"

/ {
	compatible = "qcom,seca-flex-ride-sx";
};

&{/} {
	qcom,sku-id = <0x302>;
};
